/*
 * LCD.c
 *
 *  Created on: Mar 26, 2025
 *      Author: mieszko
 */
#include "LCD.h"
uint16_t BACK_COLOR, POINT_COLOR;
unsigned int size_of_prev_string = 4;

static uint8_t asc2_1608[1520]={
0x00,0x00,0x00,0x00,0x00,0x00,0x00,0x00,0x00,0x00,0x00,0x00,0x00,0x00,0x00,0x00,
0x00,0x00,0x00,0x08,0x08,0x08,0x08,0x08,0x08,0x08,0x00,0x00,0x18,0x18,0x00,0x00,
0x00,0x48,0x6C,0x24,0x12,0x00,0x00,0x00,0x00,0x00,0x00,0x00,0x00,0x00,0x00,0x00,
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0x0C,0x32,0xC2,0x00,0x00,0x00,0x00,0x00,0x00,0x00,0x00,0x00,0x00,0x00,0x00,0x00,
};

static void LCD_Writ_Bus(char da)
{
	//bitdata=da;

	int i;
	for(i = 7; i>-1; i--)
	{
		HAL_GPIO_WritePin(GPIOA, LCD_SDA, (da>>i)&1);
		HAL_GPIO_WritePin(GPIOA, LCD_SCK, 0);
		//HAL_Delay(2);
		HAL_GPIO_WritePin(GPIOA, LCD_SCK, 1);
		//HAL_Delay(2);
	}


	/*
	LCD_SDA=bit7;LCD_SCK=0;LCD_SCK=1;
	LCD_SDA=bit6;LCD_SCK=0;LCD_SCK=1;
	LCD_SDA=bit5;LCD_SCK=0;LCD_SCK=1;
	LCD_SDA=bit4;LCD_SCK=0;LCD_SCK=1;
	LCD_SDA=bit3;LCD_SCK=0;LCD_SCK=1;
	LCD_SDA=bit2;LCD_SCK=0;LCD_SCK=1;
	LCD_SDA=bit1;LCD_SCK=0;LCD_SCK=1;
	LCD_SDA=bit0;LCD_SCK=0;LCD_SCK=1;*/
}

static void LCD_WR_DATA(uint16_t da) //zakladamy ze jest 16-bitowy
{
    HAL_GPIO_WritePin(GPIOA, LCD_AO, 1);
	LCD_Writ_Bus(da>>8);
	LCD_Writ_Bus(da);
}

static void LCD_WR_REG(char da)
{
    //LCD_AO=0;
	HAL_GPIO_WritePin(GPIOA, LCD_AO, 0);
	HAL_Delay(3);
	LCD_Writ_Bus(da);
}

static void LCD_WR_DATA8(char da)
{
    //LCD_AO=1;
	if (HAL_GPIO_ReadPin(GPIOA, LCD_AO) != GPIO_PIN_SET) {
		HAL_GPIO_WritePin(GPIOA, LCD_AO, 1);
		HAL_Delay(3);
	}
	LCD_Writ_Bus(da);
}

static void Address_set(unsigned int x1,unsigned int y1,unsigned int x2,unsigned int y2)
{
   LCD_WR_REG(0x2a);
   LCD_WR_DATA8(x1>>8);
   LCD_WR_DATA8(x1);
   LCD_WR_DATA8(x2>>8);
   LCD_WR_DATA8(x2);

   LCD_WR_REG(0x2b);
   LCD_WR_DATA8(y1>>8);
   LCD_WR_DATA8(y1);
   LCD_WR_DATA8(y2>>8);
   LCD_WR_DATA8(y2);

   LCD_WR_REG(0x2C);

}

static void LCD_DrawPoint(uint16_t x,uint16_t y)
{
	Address_set(x,y,x,y);
	LCD_WR_DATA(POINT_COLOR);
}

static void LCD_ShowChar(uint16_t x,uint16_t y,uint8_t num,uint8_t mode)
{
	uint8_t temp;
	uint8_t pos,t;
	uint16_t x0=x;
	uint16_t colortemp=POINT_COLOR;
    if(x>LCD_W-16||y>LCD_H-16)return;

	num=num-' ';
	Address_set(x,y,x+8-1,y+16-1);
	if(!mode)
	{
		for(pos=0;pos<16;pos++)
		{
			temp=asc2_1608[(uint16_t)num*16+pos];
			for(t=0;t<8;t++)
		    {
		        if(temp&0x01)POINT_COLOR=colortemp;
				else POINT_COLOR=BACK_COLOR;
				LCD_WR_DATA(POINT_COLOR);
				temp>>=1;
				x++;
		    }
			x=x0;
			y++;
		}
	}else
	{
		for(pos=0;pos<16;pos++)
		{
		    temp=asc2_1608[(uint16_t)num*16+pos];
			for(t=0;t<8;t++)
		    {
		        if(temp&0x01)LCD_DrawPoint(x+t,y+pos);//��һ����
		        temp>>=1;
		    }
		}
	}
	POINT_COLOR=colortemp;
}
/*
 void LCD_WR_REG_DATA(int reg,int da)
{
    LCD_WR_REG(reg);
	LCD_WR_DATA(da);
}*/

void Lcd_Init(void)
{

   	//LCD_CS =1;
   	HAL_GPIO_WritePin(GPIOA, LCD_CS, 1);
   	/*
	if(LCD_CS==0)
	{
	   LCD_WR_REG_DATA(0,0);
	   LCD_ShowString(0,0," ");
	   LCD_ShowNum(0,0,0,0);
	   LCD_Show2Num(0,0,0,0);
	   LCD_DrawPoint_big(0,0);
	   LCD_DrawRectangle(0,0,0,0);
	   Draw_Circle(0,0,0);
 	 }*/

   	HAL_GPIO_WritePin(GPIOA, LCD_REST, 1);
    //LCD_REST=1;
   	HAL_Delay(5);
    //delayms(5);
   	HAL_GPIO_WritePin(GPIOA, LCD_REST, 0);
	//LCD_REST=0;
   	HAL_Delay(5);
   	HAL_GPIO_WritePin(GPIOA, LCD_REST, 1);
   	HAL_GPIO_WritePin(GPIOA, LCD_CS, 1);
	//LCD_CS=1;
   	HAL_Delay(5);
   	HAL_GPIO_WritePin(GPIOA, LCD_CS, 0);

	LCD_WR_REG(0x11); //Sleep out
	HAL_Delay(120); //Delay 120ms
	//------------------------------------ST7735S Frame Rate-----------------------------------------//
	LCD_WR_REG(0xB1);
	LCD_WR_DATA8(0x05);
	LCD_WR_DATA8(0x3C);
	LCD_WR_DATA8(0x3C);
	LCD_WR_REG(0xB2);
	LCD_WR_DATA8(0x05);
	LCD_WR_DATA8(0x3C);
	LCD_WR_DATA8(0x3C);
	LCD_WR_REG(0xB3);
	LCD_WR_DATA8(0x05);
	LCD_WR_DATA8(0x3C);
	LCD_WR_DATA8(0x3C);
	LCD_WR_DATA8(0x05);
	LCD_WR_DATA8(0x3C);
	LCD_WR_DATA8(0x3C);
	//------------------------------------End ST7735S Frame Rate-----------------------------------------//
	LCD_WR_REG(0xB4); //Dot inversion
	LCD_WR_DATA8(0x03);
	LCD_WR_REG(0xC0);
	LCD_WR_DATA8(0x28);
	LCD_WR_DATA8(0x08);
	LCD_WR_DATA8(0x04);
	LCD_WR_REG(0xC1);
	LCD_WR_DATA8(0XC0);
	LCD_WR_REG(0xC2);
	LCD_WR_DATA8(0x0D);
	LCD_WR_DATA8(0x00);
	LCD_WR_REG(0xC3);
	LCD_WR_DATA8(0x8D);
	LCD_WR_DATA8(0x2A);
	LCD_WR_REG(0xC4);
	LCD_WR_DATA8(0x8D);
	LCD_WR_DATA8(0xEE);
	//---------------------------------End ST7735S Power Sequence-------------------------------------//
	LCD_WR_REG(0xC5); //VCOM
	LCD_WR_DATA8(0x1A);
	LCD_WR_REG(0x36); //MX, MY, RGB mode
	LCD_WR_DATA8(0xC0);
	//------------------------------------ST7735S Gamma Sequence-----------------------------------------//
	LCD_WR_REG(0xE0);
	LCD_WR_DATA8(0x04);
	LCD_WR_DATA8(0x22);
	LCD_WR_DATA8(0x07);
	LCD_WR_DATA8(0x0A);
	LCD_WR_DATA8(0x2E);
	LCD_WR_DATA8(0x30);
	LCD_WR_DATA8(0x25);
	LCD_WR_DATA8(0x2A);
	LCD_WR_DATA8(0x28);
	LCD_WR_DATA8(0x26);
	LCD_WR_DATA8(0x2E);
	LCD_WR_DATA8(0x3A);
	LCD_WR_DATA8(0x00);
	LCD_WR_DATA8(0x01);
	LCD_WR_DATA8(0x03);
	LCD_WR_DATA8(0x13);
	LCD_WR_REG(0xE1);
	LCD_WR_DATA8(0x04);
	LCD_WR_DATA8(0x16);
	LCD_WR_DATA8(0x06);
	LCD_WR_DATA8(0x0D);
	LCD_WR_DATA8(0x2D);
	LCD_WR_DATA8(0x26);
	LCD_WR_DATA8(0x23);
	LCD_WR_DATA8(0x27);
	LCD_WR_DATA8(0x27);
	LCD_WR_DATA8(0x25);
	LCD_WR_DATA8(0x2D);
	LCD_WR_DATA8(0x3B);
	LCD_WR_DATA8(0x00);
	LCD_WR_DATA8(0x01);
	LCD_WR_DATA8(0x04);
	LCD_WR_DATA8(0x13);
	//------------------------------------End ST7735S Gamma Sequence-----------------------------------------//
	LCD_WR_REG(0x3A); //65k mode
	LCD_WR_DATA8(0x05);
	LCD_WR_REG(0x29); //Display on

}

void LCD_Clear(uint16_t Color)
{
	uint16_t VH,VL;
	uint16_t i,j;
	VH=Color>>8;
	VL=Color;
	Address_set(0,0,LCD_W-1,LCD_H-1);
    for(i=0;i<LCD_W;i++)
	 {
	  for (j=0;j<LCD_H;j++)
	   	{
        	 LCD_WR_DATA8(VH);
			 LCD_WR_DATA8(VL);

	    }
	 }
}

uint8_t LCD_ShowString(uint16_t x,uint16_t y,const uint8_t *p)
{
	uint8_t size = 0;
    while(*p!='\0')
    {
    	size+=1;
        if(x>LCD_W-16){x=0;y+=16;}
        if(y>LCD_H-16){y=x=0;}
        LCD_ShowChar(x,y,*p,0);
        x+=8;
        p++;
    }
    return size;
}

void LCD_Clear_size(uint16_t Color, int x, int y, int x_delta)
{
	uint16_t VH,VL;
	uint16_t i,j;
	VH=Color>>8;
	VL=Color;
	int y_delta = 16;

	if(x+x_delta>LCD_W-16)
	{
		y_delta=16*(1+(x+x_delta)/(LCD_W-16));
		x=0;
		x_delta = LCD_W-1;
	}

	Address_set(x,y,x_delta+x,y_delta+y);
	for(i=0;i<=x_delta+1;i++)
	{
		for (j=0;j<=y_delta+1;j++)
		 {
			LCD_WR_DATA8(VH);
			LCD_WR_DATA8(VL);
		 }
	}
}
